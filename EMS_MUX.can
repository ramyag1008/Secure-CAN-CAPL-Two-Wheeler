/*@!Encoding:65001*/
/*
 * EMS_MUX_updated.can
 * FINAL DBC EMS transmitter
 * --------------------------
 * 0x100 EMS_Data_Msg  : 8 bytes, MUX, Counter=Byte 6, MAC=Byte 7
 * 0x101 EMS_Error_Msg : 4 bytes, Counter=Byte 2, MAC=Byte 3
 * 0x100 MUX layouts are taken directly from the final DBC:
 *   MUX 0: Engine_Speed, Engine_temperature, Gear, Throttle, IAT
 *   MUX 1: Engine_Status, Oil_Pressure, Engine_Load, Battery,
 *          Fuel_Level, Ignition_Advance
 *   MUX 2: Fuel_Level, Mass_Air_Flow, Vehicle_Speed, MAP
 * SECURITY FORMAT USED BY THE WORKING EMS PROGRAM:
 *   Plaintext application bytes = 6 bytes
 *   PKCS-style padding           = 02 02 -> 8 bytes
 *   Encrypted bytes              = CAN bytes 0..5
 *   Counter                      = CAN byte 6
 *   Truncated MAC                = CAN byte 7
 *  IMPORTANT:
 * This is a SIMULATION-NODE CAPL program.
 * Attach it to EMS_ECU under Simulation Setup, not Test Setup.
 */
 
variables
{
  // --- Secure Engine Freshness & Cryptography States ---
  byte rxCounter;
  byte rxMac;
  byte calculatedMac;
  byte expectedCounter[32]; // Tracking array to manage unique sequential freshness values per channel
 
  message EMS_Data_Msg txEMSData; /* DBC message type: EMS_Data_Msg_1 (CAN ID 0x100) */
  message EMS_Error_Msg txEMSError; /* DBC message type: EMS_Data_Msg_2 (CAN ID 0x101) */
  message 0x7E8 txEMS_DiagResp;
  
   // --- ASCON State Registers ---
  dword x0_h; 
  dword x0_l;
  dword x1_h; 
  dword x1_l;
  dword x2_h; 
  dword x2_l;
  dword x3_h; 
  dword x3_l;
  dword x4_h; 
  dword x4_l;

  // --- Intermediate Buffers for Padding & Crypto Operations ---
  byte raw0;
  byte raw1;
  byte raw2;
  byte raw3;
  byte raw4;
  byte raw5;

  byte pad0; 
  byte pad1; 
  byte pad2; 
  byte pad3; 
  byte pad4; 
  byte pad5; 
  byte pad6;
  byte pad7;

  byte cipher0; 
  byte cipher1; 
  byte cipher2; 
  byte cipher3;
  byte cipher4; 
  byte cipher5;
  
  byte globalDecryptedBlock_0; 
  byte globalDecryptedBlock_1; 
  byte globalDecryptedBlock_2; 
  byte globalDecryptedBlock_3; 
  byte globalDecryptedBlock_4; 
  byte globalDecryptedBlock_5; 
  byte globalDecryptedBlock_6;
  byte globalDecryptedBlock_7;

  // --- Network Synchronization Tracking ---
  byte firstFrameABS = 1;
  byte firstFrame120 = 1;
  byte firstFrame130 = 1;
  
  // --- Node Transmission Objects & Timers ---
  msTimer txEmsDataTimer;       // 25ms timer for EMS_Data_Msg (0x100)
  msTimer txEmsErrorTimer;      // 100ms timer for EMS_Error_Msg (0x101)
    
  byte txCounter100 = 0;        // Freshness Counter for EMS_Data_Msg (0x100)
  byte txCounter101 = 0;        // Freshness Counter for EMS_Error_Msg (0x101)
  byte muxSelector;

  // Local Application Signals for TX Simulation (DBC Mappings)
  byte simEmsMuxSelector = 0;   // MUX Selector (0x00 for Mode 0)
  byte simGearPosition = 3;     // Gear_position (3 bits)
  word simEngineSpeed = 3500;   // Engine_speed (16 bits)
  byte simEngineTemp = 85;      // Engine_temperature (8 bits)
  
  byte simSpeedErrorStatus = 0; // Speed_error_status
  byte simRpmFailure = 0;       // RPM_failure

/* Live EMS values */
  long engineSpeed;
  long engineTemp;
  long throttlePos;
  long iatSignal;
  long ignitionAdvance;

  long engineLoad;
  long batteryVoltageRaw;
  long oilPressure;
  long gearPosition;
  long engineStatus;
  long fuelLevel;
  long mafSignal;
  long vehicleSpeed;
  long mapPressure;
  
// Fault injection tracking state variables
  msTimer tmr_EMSFaultInjector;
  const int c_EMSFaultCheckInterval = 500; 
  byte g_EmsActiveFaultState = 0;
  
}  

/* ======================================================================== */
/* 1. INITIALIZATION                                                        */
/* ======================================================================== */

on preStart
{
  int i;
  for(i = 0; i < 32; i++) 
  {
    expectedCounter[i] = 0x00;
  }
}

on start
{
  txCounter100 = 0;
  txCounter101 = 0;

  /* CAPL owns these DBC messages during simulation. */
  ILDisableMsg("EMS_Data_Msg");
  ILDisableMsg("EMS_Error_Msg");
  muxSelector = 0;

  engineSpeed = 2000;
  engineTemp = 90;
  throttlePos = 15;
  iatSignal = 35;
  ignitionAdvance = 12;

  engineLoad = 40;
  batteryVoltageRaw = 140;
  oilPressure = 250;
  gearPosition = 1;
  engineStatus = 1;
  fuelLevel = 70;
  mafSignal = 80;
  vehicleSpeed = 40;
  mapPressure = 100;

  /* Final DBC specifies 25 ms for EMS_Data_Msg. */
  setTimer(txEmsDataTimer, 25);

  /* Error message is event-type in the DBC; 100 ms is used here only
     for simulation visibility. */
  setTimer(txEmsErrorTimer, 100);
  
    // FIX: Place the initial timer activation call securely here!
  setTimer(tmr_EMSFaultInjector, c_EMSFaultCheckInterval);

  write("============================================================");
  write("EMS_ECU SECURE MUX TRANSMITTER INITIALIZED");
  write("0x100 EMS_Data_Msg : MUX + Encryption + Counter + MAC");
  write("0x101 EMS_Error_Msg: Counter + MAC");
  write("============================================================");
}
/* ======================================================================== */
/* 2. CRYPTOGRAPHY ENGINE: PERMUTATIONS & UTILITIES (COMMON FOR ALL NODES)   */
/* ======================================================================== */

dword RotateRight_H(dword h, dword l, int n)
{
  if (n < 32) return (h >> n) | (l << (32 - n));
  return (l >> (n - 32)) | (h << (64 - n));
}

dword RotateRight_L(dword h, dword l, int n)
{
  if (n < 32) return (l >> n) | (h << (32 - n));
  return (h >> (n - 32)) | (l << (64 - n));
}

void Ascon_Initialize_State()
{
  x0_h = 0x80400c06; 
  x0_l = 0x00000000;
  x1_h = 0x01020304; 
  x1_l = 0x05060708;
  x2_h = 0x090A0B0C; 
  x2_l = 0x0D0E0F10;
  x3_h = 0x00000000; 
  x3_l = 0x00000000;
  x4_h = 0x00000000; 
  x4_l = 0x00000000;

  Ascon_Permute_6();
}

void Ascon_Permute_6()
{
  int r;
  dword t0_h; 
  dword t0_l; 
  dword t1_h;
  dword t1_l; 
  dword t2_h; 
  dword t2_l;
  dword t3_h; 
  dword t3_l; 
  dword t4_h; 
  dword t4_l;
  byte current_rc;

  for (r = 0; r < 6; r++)
  {
    switch (r)
    {
      case 0: current_rc = 0x9A; 
        break;
      case 1: current_rc = 0x8B; 
        break;
      case 2: current_rc = 0x7C; 
        break;
      case 3: current_rc = 0x6D; 
        break;
      case 4: current_rc = 0x5E; 
        break;
      case 5: current_rc = 0x4F;
        break;
      default: current_rc = 0x00; 
        break;
    }

    x2_l = x2_l ^ current_rc;

    x0_h = x0_h ^ x4_h; 
    x0_l = x0_l ^ x4_l;
    x4_h = x4_h ^ x3_h; 
    x4_l = x4_l ^ x3_l;
    x2_h = x2_h ^ x1_h; 
    x2_l = x2_l ^ x1_l;

    t0_h = ~x0_h; 
    t0_l = ~x0_l;
    t1_h = ~x1_h; 
    t1_l = ~x1_l;
    t2_h = ~x2_h; 
    t2_l = ~x2_l;
    t3_h = ~x3_h; 
    t3_l = ~x3_l;
    t4_h = ~x4_h; 
    t4_l = ~x4_l;

    x0_h = x0_h ^ (t1_h & x2_h); 
    x0_l = x0_l ^ (t1_l & x2_l);
    x1_h = x1_h ^ (t2_h & x3_h); 
    x1_l = x1_l ^ (t2_l & x3_l);
    x2_h = x2_h ^ (t3_h & x4_h); 
    x2_l = x2_l ^ (t3_l & x4_l);
    x3_h = x3_h ^ (t4_h & t0_h); 
    x3_l = x3_l ^ (t4_l & t0_l);
    x4_h = x4_h ^ (t0_h & x1_h); 
    x4_l = x4_l ^ (t0_l & x1_l);

    x1_h = x1_h ^ x0_h; 
    x1_l = x1_l ^ x0_l;
    x0_h = x0_h ^ x4_h;
    x0_l = x0_l ^ x4_l;
    x3_h = x3_h ^ x2_h; 
    x3_l = x3_l ^ x2_l;
    x2_h = ~x2_h;       
    x2_l = ~x2_l;

    t0_h = x0_h; 
    t0_l = x0_l;
    x0_h = x0_h ^ RotateRight_H(t0_h, t0_l, 19) ^ RotateRight_H(t0_h, t0_l, 28);
    x0_l = x0_l ^ RotateRight_L(t0_h, t0_l, 19) ^ RotateRight_L(t0_h, t0_l, 28);

    t1_h = x1_h; 
    t1_l = x1_l;
    x1_h = x1_h ^ RotateRight_H(t1_h, t1_l, 61) ^ RotateRight_H(t1_h, t1_l, 39);
    x1_l = x1_l ^ RotateRight_L(t1_h, t1_l, 61) ^ RotateRight_L(t1_h, t1_l, 39);

    t2_h = x2_h; 
    t2_l = x2_l;
    x2_h = x2_h ^ RotateRight_H(t2_h, t2_l, 1)  ^ RotateRight_H(t2_h, t2_l, 6);
    x2_l = x2_l ^ RotateRight_L(t2_h, t2_l, 1)  ^ RotateRight_L(t2_h, t2_l, 6);

    t3_h = x3_h; 
    t3_l = x3_l;
    x3_h = x3_h ^ RotateRight_H(t3_h, t3_l, 10) ^ RotateRight_H(t3_h, t3_l, 17);
    x3_l = x3_l ^ RotateRight_L(t3_h, t3_l, 10) ^ RotateRight_L(t3_h, t3_l, 17);

    t4_h = x4_h; 
    t4_l = x4_l;
    x4_h = x4_h ^ RotateRight_H(t4_h, t4_l, 7)  ^ RotateRight_H(t4_h, t4_l, 41);
    x4_l = x4_l ^ RotateRight_L(t4_h, t4_l, 7)  ^ RotateRight_L(t4_h, t4_l, 41);
  }
}

/* ======================================================================== */
/* 3. ENCRYPTION CORE (COMMON FOR ALL NODES)                                */
/* ======================================================================== */

void EncryptSixBytes(byte r0, byte r1, byte r2, byte r3, byte r4, byte r5)
{
  dword msg_h; 
  dword msg_l;
  
  pad0 = r0; 
  pad1 = r1; 
  pad2 = r2; 
  pad3 = r3; 
  pad4 = r4; 
  pad5 = r5;
  pad6 = 0x02; 
  pad7 = 0x02; // PKCS#7 standard padding bytes

  Ascon_Initialize_State();
  msg_h = ((dword)pad0 << 24) | ((dword)pad1 << 16) | ((dword)pad2 << 8) | (dword)pad3;
  msg_l = ((dword)pad4 << 24) | ((dword)pad5 << 16) | ((dword)pad6 << 8) | (dword)pad7;

  x0_h = x0_h ^ msg_h; 
  x0_l = x0_l ^ msg_l;
  
  cipher0 = (byte)((x0_h >> 24) & 0xFF); 
  cipher1 = (byte)((x0_h >> 16) & 0xFF);
  cipher2 = (byte)((x0_h >> 8)  & 0xFF); 
  cipher3 = (byte)(x0_h & 0xFF);
  cipher4 = (byte)((x0_l >> 24) & 0xFF); 
  cipher5 = (byte)((x0_l >> 16) & 0xFF);
}

/* ======================================================================== */
/* 4. MAC GENERATION (COMMON FOR ALL NODES)                                 */
/* ======================================================================== */

byte Generate_Local_MAC()
{
  Ascon_Permute_6();
  return (byte)(x3_l & 0xFF); 
}
/* ------------------------------------------------------------------------- */
/* Generate MAC exactly as the working sender/receiver state operation.     */
/* ------------------------------------------------------------------------- */

byte Generate_Verification_MAC(byte p0, byte p1, byte p2, byte p3, byte p4, byte p5)
{
  dword msg_h; dword msg_l;

  msg_h = (p0 << 24) | (p1 << 16) | (p2 << 8)  | p3;
  msg_l = (p4 << 24) | (p5 << 16) | (0x02 << 8) | 0x02;

  Ascon_Initialize_State();
  x0_h = x0_h ^ msg_h;
  x0_l = x0_l ^ msg_l;

  Ascon_Permute_6();
  return (byte)(x3_l & 0xFF);
}

/* ======================================================================== */
/* 5. DECRYPTION ENGINE (COMMON FOR ALL NODES)                              */
/* ======================================================================== */

void Secure_Decrypt(byte c0, byte c1, byte c2, byte c3, byte c4, byte c5)
{
  dword cipher_h; 
  dword cipher_l;
  dword recovered_msg_h; 
  dword recovered_msg_l;
  byte pad6; byte pad7;

  Ascon_Initialize_State();

  cipher_h = (c0 << 24) | (c1 << 16) | (c2 << 8) | c3;

  pad6 = 0x02 ^ (byte)((x0_l >> 8) & 0xFF);
  pad7 = 0x02 ^ (byte)(x0_l & 0xFF);

  cipher_l = (c4 << 24) | (c5 << 16) | (pad6 << 8) | pad7;

  recovered_msg_h = cipher_h ^ x0_h;
  recovered_msg_l = cipher_l ^ x0_l;

  globalDecryptedBlock_0 = (byte)((recovered_msg_h >> 24) & 0xFF);
  globalDecryptedBlock_1 = (byte)((recovered_msg_h >> 16) & 0xFF);
  globalDecryptedBlock_2 = (byte)((recovered_msg_h >> 8)  & 0xFF);
  globalDecryptedBlock_3 = (byte)(recovered_msg_h & 0xFF);

  globalDecryptedBlock_4 = (byte)((recovered_msg_l >> 24) & 0xFF);
  globalDecryptedBlock_5 = (byte)((recovered_msg_l >> 16) & 0xFF);
  globalDecryptedBlock_6 = (byte)((recovered_msg_l >> 8)  & 0xFF);
  globalDecryptedBlock_7 = (byte)(recovered_msg_l & 0xFF);

  x0_h = cipher_h;
  x0_l = cipher_l;
}
/* ======================================================================== */
/* 6. SYSTEM TRANSLATION LAYER (UTILITIES)                                 */
/* ======================================================================== */

byte GetCounterIndex(dword id)
{
  switch (id)
  {
    case 0x100: return 0;  // EMS_Data_Msg
    case 0x110: return 1;  // ABS_Sensor_Msg
    case 0x120: return 2;  // ABS_Sensor_Error_msg
    case 0x130: return 3;  // Cluster_indication
    case 0x101: return 4;  // EMS_Error_Msg
    default:    return 31;
  }
}

/* ======================================================================== */
/* MUX 0x100 payload construction with Raw Input Signal Logging             */
/* ======================================================================== */

void BuildEMS_MUX0()
{
  word speedRaw; byte throttleRaw; byte iatRaw; byte gearRaw; byte tempRaw;
  speedRaw = (word)engineSpeed;
  tempRaw = (byte)engineTemp;
  throttleRaw = (byte)(throttlePos / 0.5);
  iatRaw = (byte)(iatSignal + 40);
  gearRaw = (byte)(gearPosition & 0x07);

  raw0 = 0x00 | (gearRaw << 4);
  raw1 = (byte)(speedRaw & 0xFF);
  raw2 = (byte)((speedRaw >> 8) & 0xFF);
  raw3 = tempRaw;
  raw4 = throttleRaw;
  raw5 = iatRaw;

  write("DEBUG [EMS_ECU] [STEP 1] Raw Input Signals (0x100-0x0): Speed=0x%04X (%d) | Temp=0x%02X (%d) | Gear=0x%X | Throttle=0x%02X | IAT=0x%02X", 
        speedRaw, speedRaw, tempRaw, tempRaw, gearRaw, throttleRaw, iatRaw);
}

void BuildEMS_MUX1()
{
  word oilRaw; byte ignRaw;
  oilRaw = (word)(oilPressure & 0x03FF);
  ignRaw = (byte)(ignitionAdvance / 0.5);

  raw0 = (byte)(0x01 | ((engineStatus & 0x03) << 4) | ((oilRaw & 0x03) << 6));
  raw1 = (byte)((oilRaw >> 2) & 0xFF);
  raw2 = (byte)(engineLoad & 0xFF);
  raw3 = (byte)(batteryVoltageRaw & 0xFF);
  raw4 = (byte)(fuelLevel & 0xFF);
  raw5 = ignRaw;

  write("DEBUG [EMS_ECU] [STEP 1] Raw Input Signals (0x100-0x1): Status=0x%X | Oil=0x%03X (%d) | Load=0x%02X | Battery=0x%02X | Fuel=0x%02X | Ign=0x%02X", 
        (engineStatus & 0x03), oilRaw, oilRaw, raw2, raw3, raw4, ignRaw);
}

void BuildEMS_MUX2()
{
  word speedRaw;
  speedRaw = (word)vehicleSpeed;

  raw0 = 0x02;
  raw1 = (byte)(fuelLevel & 0xFF);
  raw2 = (byte)(mafSignal & 0xFF);
  raw3 = (byte)(speedRaw & 0xFF);
  raw4 = (byte)((speedRaw >> 8) & 0xFF);
  raw5 = (byte)(mapPressure & 0xFF);

  write("DEBUG [EMS_ECU] [STEP 1] Raw Input Signals (0x100-0x2): Fuel=0x%02X | MAF=0x%02X | VehSpeed=0x%04X (%d) | MAP=0x%02X", 
        raw1, raw2, speedRaw, speedRaw, raw5);
}
/* ======================================================================== */
/* Generate realistic live values                                           */
/* ======================================================================== */

void UpdateLiveEMSValues()
{
  engineSpeed += random(41) - 20;     
  if (engineSpeed < 1000) engineSpeed = 1000;  
  if (engineSpeed > 5000) engineSpeed = 5000;
  engineTemp += random(3) - 1;       
  if (engineTemp < 70) engineTemp = 70;         
  if (engineTemp > 110) engineTemp = 110;
  throttlePos += random(5) - 2;      
  if (throttlePos < 0) throttlePos = 0;         
  if (throttlePos > 100) throttlePos = 100;
  iatSignal += random(3) - 1;        
  if (iatSignal < 20) iatSignal = 20;          
  if (iatSignal > 50) iatSignal = 50;
  ignitionAdvance += random(3) - 1;  
  if (ignitionAdvance < 5) ignitionAdvance = 5; 
  if (ignitionAdvance > 25) ignitionAdvance = 25;
  engineLoad = random(101);
  batteryVoltageRaw = 140 + random(40); 
  oilPressure = random(501);
  gearPosition = random(6);
  engineStatus = random(2);
  fuelLevel = random(101);
  mafSignal = random(251);
  vehicleSpeed = random(151);
  mapPressure = random(251);
}

/* ======================================================================== */
/* 0x100 EMS_Data_Msg - MUX + encryption + MAC                              */
/* ======================================================================== */

on timer txEmsDataTimer
{
  byte computedMac;

    UpdateLiveEMSValues();

  write("");
  write("============================================================");
  write("[EMS_TX] CAN ID 0x100 - EMS_Data_Msg");
  write("============================================================");

  /* -------------------------------------------------------- */
  /* STEP 1: Select MUX and build plaintext                    */
  /* -------------------------------------------------------- */

  if (muxSelector == 0)
  {
    BuildEMS_MUX0();

    write("[EMS_TX] ID=0x100 | MUX=0");
    write("[EMS_TX] Speed=%d RPM | Temp=%d C | Gear=%d", engineSpeed, engineTemp, gearPosition);
    write("[EMS_TX] Throttle=%d %% | IAT=%d C", throttlePos, iatSignal);
  }
  else if (muxSelector == 1)
  {
    BuildEMS_MUX1();

    write("[EMS_TX] ID=0x100 | MUX=1");
    write("[EMS_TX] Load=%d %% | BatteryRaw=%d",engineLoad, batteryVoltageRaw);
    write("[EMS_TX] Oil=%d kPa | Status=%d | Fuel=%d %%",oilPressure, engineStatus, fuelLevel);
    write("[EMS_TX] Ignition=%d deg", ignitionAdvance);
  }
  else
  {
    BuildEMS_MUX2();

    write("[EMS_TX] ID=0x100 | MUX=2");
    write("[EMS_TX] Fuel=%d %% | MAF=%d g/s",fuelLevel, mafSignal);
    write("[EMS_TX] VehicleSpeed=%d km/h | MAP=%d kPa",vehicleSpeed, mapPressure);
    }
  /* -------------------------------------------------------- */
  /* PLAINTEXT                                                 */
  /* -------------------------------------------------------- */

  write("[EMS_TX] STEP 1 - Plaintext: [%02X %02X %02X %02X %02X %02X]",raw0, raw1, raw2, raw3, raw4, raw5);
  /* -------------------------------------------------------- */
  /* STEP 2: ASCON encryption + padding                        */
  /* -------------------------------------------------------- */

  EncryptSixBytes(raw0, raw1, raw2, raw3, raw4, raw5);

  write("[EMS_TX] STEP 2 - Padded Plaintext = [%02X %02X %02X %02X %02X %02X %02X %02X]",
        pad0, pad1, pad2, pad3, pad4, pad5, pad6, pad7);
  write("[EMS_TX] STEP 3 - Ciphertext = [%02X %02X %02X %02X %02X %02X]",
        cipher0, cipher1, cipher2, cipher3, cipher4, cipher5);

  /* -------------------------------------------------------- */
  /* STEP 3: MAC                                                */
  /* -------------------------------------------------------- */

  Ascon_Permute_6();
  computedMac = (byte)(x3_l & 0xFF);
  
  write("[EMS_TX] STEP 4 - MAC = 0x%02X", computedMac);

  /* -------------------------------------------------------- */
  /* STEP 5: Final CAN frame                                   */
  /* -------------------------------------------------------- */

  txEMSData.id = 0x100;
  txEMSData.dlc = 8;

  txEMSData.byte(0) = cipher0;
  txEMSData.byte(1) = cipher1;
  txEMSData.byte(2) = cipher2;
  txEMSData.byte(3) = cipher3;
  txEMSData.byte(4) = cipher4;
  txEMSData.byte(5) = cipher5;
  txEMSData.byte(6) = txCounter100;
  txEMSData.byte(7) = computedMac;

  /* -------------------------------------------------------- */
  /* STEP 4: Counter                                            */
  /* -------------------------------------------------------- */

  write("[EMS_TX] STEP 5 - Counter = 0x%02X", txCounter100);
    
  write("[EMS_TX] STEP 6 - Final CAN Frame:");
  write("         ID      = 0x100");
  write("         DLC     = 8");
  write("         DATA    = [%02X %02X %02X %02X %02X %02X %02X %02X]",
        txEMSData.byte(0),
        txEMSData.byte(1),
        txEMSData.byte(2),
        txEMSData.byte(3),
        txEMSData.byte(4),
        txEMSData.byte(5),
        txEMSData.byte(6),
        txEMSData.byte(7));

  write("[EMS_TX] STATUS = FRAME TRANSMITTED");
  write("============================================================");
  write("");
    
output(txEMSData);
  txCounter100++;

  muxSelector++;

  if (muxSelector > 2)
    muxSelector = 0;

  setTimer(txEmsDataTimer, 25);
}

/* ======================================================================== */
/* 0x101 EMS_Error_Msg - 4 byte DBC layout                                  */
/* ======================================================================== */

on timer txEmsErrorTimer
{
  byte errorBits;
  byte computedMac;
  
  write("");
  write("============================================================");
  write("[EMS_TX] CAN ID 0x101 - EMS_Error_Msg");
  write("============================================================");

  /* -------------------------------------------------------- */
  /* STEP 1 - Error / Status Data                             */
  /* -------------------------------------------------------- */

  errorBits = 0x00;
  txEMSError.id = 0x101;
  txEMSError.dlc = 4;

  txEMSError.byte(0) = errorBits;
  txEMSError.byte(1) = 0x00;

  write("[EMS_TX] STEP 1 - Error Data");
  write("[EMS_TX] Error Byte 0 = 0x%02X",
        txEMSError.byte(0));

  write("[EMS_TX] Status Byte 1 = 0x%02X",
        txEMSError.byte(1));

  /* -------------------------------------------------------- */
  /* STEP 2 - Counter                                         */
  /* -------------------------------------------------------- */

  txEMSError.byte(2) = txCounter101;

  write("[EMS_TX] STEP 2 - Counter");
  write("[EMS_TX] Counter = 0x%02X",
        txEMSError.byte(2));

  /* -------------------------------------------------------- */
  /* STEP 3 - MAC                                             */
  /* -------------------------------------------------------- */

  raw0 = txEMSError.byte(0);
  raw1 = txEMSError.byte(1);
  raw2 = txEMSError.byte(2);
  raw3 = 0x00;
  raw4 = 0x00;
  raw5 = 0x00;

  EncryptSixBytes(raw0, raw1, raw2, raw3, raw4, raw5);
  computedMac = Generate_Verification_MAC(raw0, raw1, raw2, raw3, raw4, raw5);

  txEMSError.byte(3) = computedMac;

 write("[EMS_TX] STEP 3 - MAC");
  write("[EMS_TX] MAC = 0x%02X",
        computedMac);

  /* -------------------------------------------------------- */
  /* STEP 4 - Final CAN Frame                                */
  /* -------------------------------------------------------- */

  write("[EMS_TX] STEP 4 - Final CAN Frame");
  write("[EMS_TX] ID   = 0x101");
  write("[EMS_TX] DLC  = 4");

  write("[EMS_TX] DATA = [%02X %02X %02X %02X]",
        txEMSError.byte(0),
        txEMSError.byte(1),
        txEMSError.byte(2),
        txEMSError.byte(3));

  /* -------------------------------------------------------- */
  /* STEP 5 - Transmit                                        */
  /* -------------------------------------------------------- */

  output(txEMSError);

  write("[EMS_TX] 0x101 ERROR FRAME TRANSMITTED");
  write("============================================================");
  write("");

  txCounter101++;

  setTimer(txEmsErrorTimer, 100);
}

void VerifyClusterIndication(
    byte b0,
    byte b1, 
    byte b2, 
    byte b3,
    byte b4, 
    byte b5, 
    byte b6, 
    byte b7)
{
   byte calculatedMac;
  write("");
  write("================================================");
  write("[EMS_RX] CAN ID 0x130 - Cluster_Indication");
  write("================================================");

  write("[EMS_RX] STEP 1 - Received CAN Frame");
  write("[EMS_RX] DATA = [%02X %02X %02X %02X %02X %02X %02X %02X]",
        b0,b1,b2,b3,b4,b5,b6,b7);

  /* Counter */
  write("[EMS_RX] STEP 2 - Counter Verification");
  write("[EMS_RX] Received Counter = 0x%02X", b6);

  if (b6 != expectedCounter[3])
  {
    write("[EMS_RX] COUNTER = INVALID");
    write("[EMS_RX] FRAME = REJECTED");
    return;
  }

  write("[EMS_RX] COUNTER = VALID");

  /* Decryption */
  Secure_Decrypt(b0,b1,b2,b3,b4,b5);

  write("[EMS_RX] STEP 3 - Decrypted Data");
  write("[EMS_RX] DATA = [%02X %02X %02X %02X %02X %02X]",
        globalDecryptedBlock_0,
        globalDecryptedBlock_1,
        globalDecryptedBlock_2,
        globalDecryptedBlock_3,
        globalDecryptedBlock_4,
        globalDecryptedBlock_5);

  /* MAC */
  calculatedMac = Generate_Verification_MAC(
        globalDecryptedBlock_0,
        globalDecryptedBlock_1,
        globalDecryptedBlock_2,
        globalDecryptedBlock_3,
        globalDecryptedBlock_4,
        globalDecryptedBlock_5);

  write("[EMS_RX] STEP 4 - MAC Verification");
  write("[EMS_RX] Received MAC   = 0x%02X", b7);
  write("[EMS_RX] Calculated MAC = 0x%02X", calculatedMac);

  if (b7 != calculatedMac)
  {
    write("[EMS_RX] MAC = INVALID");
    write("[EMS_RX] FRAME = REJECTED");
    return;
  }

  write("[EMS_RX] MAC = VALID");

  /* Decode */
  write("[EMS_RX] STEP 5 - Recovered Cluster Data");

  write("[EMS_RX] ABS Ride Mode     = %d",
        globalDecryptedBlock_0);

  write("[EMS_RX] EMS Ride Mode     = %d",
        globalDecryptedBlock_1);

  write("[EMS_RX] Vehicle Ride Mode = %d",
        globalDecryptedBlock_2);

  write("[EMS_RX] Reserved = [%02X %02X %02X]",
        globalDecryptedBlock_3,
        globalDecryptedBlock_4,
        globalDecryptedBlock_5);

  expectedCounter[3]++;

  write("[EMS_RX] STEP 6 - 0x130 FRAME ACCEPTED");
  write("================================================");
}
// Add this new timer function block anywhere outside other functions
on timer tmr_EMSFaultInjector
{
  byte computedMac;
  byte previousFaultState;
  
  previousFaultState = g_EmsActiveFaultState;
  
  // Roll a random 0-99 value. Inject a fault if the value falls under 12 (12% chance every 500ms)
  if (random(100) < 12)
  {
    g_EmsActiveFaultState = 1; // Set active component malfunction flag
  }
  else
  {
    g_EmsActiveFaultState = 0; // Clear fault path
  }
  
  // Transmit the 4-byte Event frame ONLY when a new error occurs or a hard fault clears
  if (g_EmsActiveFaultState != previousFaultState)
  {
    // Build plaintext payload bytes
    raw0 = (g_EmsActiveFaultState == 1) ? 0xFA : 0x00; // Error Code pattern
    raw1 = (g_EmsActiveFaultState == 1) ? 0x03 : 0x00; // Component ID breakdown
    
    // Note: Per final layout configuration rules, 0x101 uses Byte 2 for Counter and Byte 3 for MAC
    // Generate validation tag across application bytes 0 and 1
    computedMac = Generate_Verification_MAC(raw0, raw1, 0x00, 0x00, 0x00, 0x00);
    
    txEMSError.id = 0x101;
    txEMSError.dlc = 4;
    txEMSError.byte(0) = raw0;
    txEMSError.byte(1) = raw1;
    txEMSError.byte(2) = txCounter101; // Append localized channel counter
    txEMSError.byte(3) = computedMac;  // Append truncated ASCON signature tag
    
    output(txEMSError);
    txCounter101++;
    
    write("SECURITY [EMS_Tx] [EVENT INJECTED] 0x101 Status Changed! ActiveFault=%d", g_EmsActiveFaultState);
  }
  
  // Rearm the pseudo-random injector loop check interval
  setTimer(tmr_EMSFaultInjector, 500);
}

void HandleEMS_Diagnostic(
  byte b0,
  byte b1,
  byte b2,
  byte b3,
  byte b4,
  byte b5,
  byte b6,
  byte b7)
{
  write("");
  write("============================================================");
  write("[EMS_RX] CAN ID 0x7E0 - Diagnostic Request");
  write("[EMS_RX] DATA = [%02X %02X %02X %02X %02X %02X %02X %02X]",
        b0,b1,b2,b3,b4,b5,b6,b7);

  write("[EMS_RX] Diagnostic Request Received");

  txEMS_DiagResp.id = 0x7E8;
  txEMS_DiagResp.dlc = 8;

  txEMS_DiagResp.byte(0) = 0x50;
  txEMS_DiagResp.byte(1) = b1;
  txEMS_DiagResp.byte(2) = 0x00;
  txEMS_DiagResp.byte(3) = 0x00;
  txEMS_DiagResp.byte(4) = 0x00;
  txEMS_DiagResp.byte(5) = 0x00;
  txEMS_DiagResp.byte(6) = 0x00;
  txEMS_DiagResp.byte(7) = 0x00;

  write("[EMS_TX] CAN ID 0x7E8 - Diagnostic Response");
  write("[EMS_TX] DATA = [%02X %02X %02X %02X %02X %02X %02X %02X]",
        txEMS_DiagResp.byte(0),
        txEMS_DiagResp.byte(1),
        txEMS_DiagResp.byte(2),
        txEMS_DiagResp.byte(3),
        txEMS_DiagResp.byte(4),
        txEMS_DiagResp.byte(5),
        txEMS_DiagResp.byte(6),
        txEMS_DiagResp.byte(7));

  output(txEMS_DiagResp);

  write("[EMS_TX] 0x7E8 DIAGNOSTIC RESPONSE TRANSMITTED");
  write("============================================================");
}

on message *
{
  dword id;
  byte b0; 
  byte b1; 
  byte b2; 
  byte b3; 
  byte b4; 
  byte b5; 
  byte b6; 
  byte b7;
  id = this.id;
  
  if (this.dlc < 8) 
    return;
  b0 = this.byte(0);
  b1 = 0;
  b2 = 0; 
  b3 = 0; 
  b4 = 0; 
  b5 = 0; 
  b6 = 0; 
  b7 = 0;
  
  if (this.dlc > 1) b1 = this.byte(1); 
  if (this.dlc > 2) b2 = this.byte(2);
  if (this.dlc > 3) b3 = this.byte(3); 
  if (this.dlc > 4) b4 = this.byte(4);
  if (this.dlc > 5) b5 = this.byte(5); 
  if (this.dlc > 6) b6 = this.byte(6);
  if (this.dlc > 7) b7 = this.byte(7);
  
    // FIX: Drop self-transmitted frames to stop duplicate TX logging
  if (this.dir == tx)
    return;
  
  switch (id)
  {
    case 0x130: 
      if (this.dlc == 8) 
        VerifyClusterIndication(this.byte(0),this.byte(1),this.byte(2),this.byte(3),this.byte(4),this.byte(5),this.byte(6),this.byte(7)); 
      break;
      
    case 0x7E0:
      if (this.dlc >= 2)
        HandleEMS_Diagnostic(this.byte(0),this.byte(1),this.byte(2),this.byte(3),this.byte(4),this.byte(5),this.byte(6),this.byte(7));
      break;
        
      default: 
      break;
    }
  }